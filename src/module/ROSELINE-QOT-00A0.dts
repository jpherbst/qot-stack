/dts-v1/;
/plugin/;
 
/ {
    /* what boards are we compatible with */
    compatible = "ti,beaglebone", "ti,beaglebone-black";
 
    /* identification */
    part-number = "ROSELINE-QOT";
 
    /* special version ignores EEPROM */
    version = "00A0";
 
    /* pin multiplexing */
    fragment@0 {
        target = <&am33xx_pinmux>;
        __overlay__ {
            qot_pins: qot_pins {
                pinctrl-single,pins = <
                    0x90  0x22      /* P8.7   MODE2 TIMER4 - CAPTURE   */
                    0x9C  0x22      /* P8.9   MODE2 TIMER5 - CAPTURE  */
                    0x98  0x22      /* P8.10  MODE2 TIMER6 - CAPTURE */
                    0x94  0x22      /* P8.8   MODE2 TIMER7 - CAPTURE */
                >;
            };
        };
    };
 
    /* define the basic driverset for pinmuxing timers and initializing the qot kernel */
    fragment@1 {
        target-path="/";
        __overlay__ {
            qot_am335x {
                compatible = "qot_am335x";
                status = "okay";
                core   = <&timer3 0>; // (0=CLK-SYS-24MHz, 1=CLK-SYS-32kHz, 2=TCLKLIN)
                timer4 = <&timer4 0>; // (0=CAP-RISING, 1=CAP-FALLING, 2=CAP-BOTH, 3=COMPARE)
                timer5 = <&timer5 3>; // (0=CAP-RISING, 1=CAP-FALLING, 2=CAP-BOTH, 3=COMPARE)
                timer6 = <&timer6 0>; // (0=CAP-RISING, 1=CAP-FALLING, 2=CAP-BOTH, 3=COMPARE)
                timer7 = <&timer7 3>; // (0=CAP-RISING, 1=CAP-FALLING, 2=CAP-BOTH, 3=COMPARE)
                pinctrl-names = "default";
                pinctrl-0 = <&qot_pins>;
            };
        };

    };
};